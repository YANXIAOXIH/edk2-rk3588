// SPDX-License-Identifier: (GPL-2.0+ OR MIT)
/*
 * Copyright (c) 2022 Rockchip Electronics Co., Ltd.
 *
 */

#include "rk3588-orangepi-5-max.dts"

/ {
	model = "LemonPi Pi1";
	compatible = "lemonpi,rk3588-lemonpi-pi1", "rockchip,rk3588";
};